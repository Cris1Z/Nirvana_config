## boards/shields/Kconfig.defconfig
```kconfig
if SHIELD_NIRVANA_LEFT

# Name must be less than 16 characters long!
config ZMK_KEYBOARD_NAME
    default "Nirvana"

config ZMK_SPLIT_ROLE_CENTRAL
    default y


# Other settings

config ZMK_POINTING
    default y
# Assuming pointing device uses SPI
config SPI
    default y

endif


if SHIELD_MY_KEYBOARD_LEFT || SHIELD_MY_KEYBOARD_RIGHT

config ZMK_SPLIT
    default y

endif
```

## boards/shields/Kconfig.shield
```kconfig
# No whitespace after the comma or in your part name!
config SHIELD_NIRVANA_LEFT
    def_bool $(shields_list_contains,nirvana_left)

# No whitespace after the comma or in your part name!
config SHIELD_NIRVANA_RIGHT
    def_bool $(shields_list_contains,nirvana_right)
```

## config/west.yml
```yaml
manifest:
  defaults:
    revision: v0.3
  remotes:
    - name: zmkfirmware
      url-base: https://github.com/zmkfirmware
    - name: petejohanson # <-- enable the drivers
      url-base: https://github.com/petejohanson
    # Additional modules containing boards/shields/custom code can be listed here as well
    # See https://docs.zephyrproject.org/3.2.0/develop/west/manifest.html#projects
  projects:
    - name: zmk
      remote: zmkfirmware
      import: app/west.yml
    - name: cirque-input-module # <-- enable the drivers
      remote: petejohanson
      revision: main
  self:
    path: config
```
