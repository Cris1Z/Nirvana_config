#include "nirvana.dtsi"
#include <dt-bindings/zmk/input_transform.h>
#include <input/processors.dtsi>
#include <zephyr/dt-bindings/input/input-event-codes.h>

&glidepoint_listener {
    status = "okay";
    device = <&glidepoint_split>;
    input-processors = <&zip_xy_scaler 3 2>;
};

&left1_encoder {
    status = "okay";
};

// 配置左边的kscan GPIO
// 根据你的实际硬件接线修改这些引脚
&kscan0 {
    col-gpios
        = <&pro_micro 21 GPIO_ACTIVE_HIGH>
        ;
};
