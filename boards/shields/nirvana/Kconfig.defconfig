## boards/shields/nirvana/Kconfig.defconfig
```kconfig
if SHIELD_NIRVANA_LEFT

# Name must be less than 16 characters long!
config ZMK_KEYBOARD_NAME
    default "Nirvana"

config ZMK_SPLIT_ROLE_CENTRAL
    default y


# Other settings

config ZMK_POINTING
    default y
# Assuming pointing device uses SPI
config SPI
    default y

config ZMK_BLE_EXPERIMENTAL_CONN
    default y
config ZMK_BLE_MOUSE_REPORT_QUEUE_SIZE
    default 1
config BT_PERIPHERAL_PREF_MAX_INT
    default 8

endif


if SHIELD_NIRVANA_LEFT || SHIELD_NIRVANA_RIGHT

config ZMK_SPLIT
    default y

endif
```
